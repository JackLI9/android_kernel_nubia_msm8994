/*PM99 battery profile tuned from QCT
comments : #2129242_Compal_PM99_ModelA_3040mAh_Master_Sept10th2015
CEI implemented this battery profile on sept 13, 2015*/

qcom,apak-3000mah-10k {
	qcom,max-voltage-uv = <4400000>;
	qcom,nom-batt-capacity-mah = <3040>;
	qcom,batt-id-kohm = <10>;
	qcom,battery-beta = <3435>;
	qcom,battery-type = "apak-3000mah-10k";
	qcom,chg-rslow-comp-c1 = <3475480>;
	qcom,chg-rslow-comp-c2 = <5579670>;
	qcom,chg-rs-to-rslow = <731987>;
	qcom,chg-rslow-comp-thr = <0xAF>;
	qcom,checksum = <0x3009>;
	qcom,gui-version = "PMI8994GUI - 2.1.6.8";
	qcom,fg-profile-data = [
		 F1 83 75 7D 
		 A1 81 25 7C 
		 60 83 56 6D 
		 D5 83 FE 8D 
		 2C 82 61 99 
		 13 BC 2B C8 
		 5B 0F 05 88 
		 EC 7D E6 81 
		 5E 7C 55 83 
		 30 69 2B 7A 
		 2F 87 44 82 
		 E4 99 36 BD 
		 4B CA 59 0D 
		 34 0C 8A 5B 
		 14 70 77 FE 
		 B4 3E 20 44 
		 36 3B 00 00 
		 0A 4D 85 33 
		 27 40 00 00 
		 00 00 00 00 
		 00 00 00 00 
		 33 6A 33 69 
		 D9 71 8B 8B 
		 B7 76 D2 6B 
		 FF 59 D4 82 
		 15 75 4C 69 
		 E3 7E 34 A9 
		 1D 87 62 CD 
		 64 A0 71 0C 
		 28 00 FF 36 
		 F0 11 30 03 
		 00 00 00 0C 
	];
};
