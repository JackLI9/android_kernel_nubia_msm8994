## drivers/hwid/Kconfig
```kconfig
#
# CEI HARDWARE ID drivers
#

config CEI_HARDWARE_ID
	bool "CEI Hardware ID Module"
```

## drivers/input/misc/yas537/Kconfig
```kconfig
config SENSORS_YAS_MAGNETOMETER
	tristate "Yamaha 3-Axis Magnetometer"
	help
	  Say Y here to add support for the Yamaha 3-Axis Magnetometer.

config SENSORS_YAS_ACCELEROMETER
	tristate "Yamaha 3-Axis Accelerometer"
	help
	  Say Y here to add support for the Yamaha 3-Axis Accelerometer.
```

## drivers/platform/compal/Kconfig
```kconfig
# Compal configuration options

config MACH_COMPAL
	bool "Compal device"
	depends on ARCH_MSM
	help
	  Support for Compal products

config MACH_COMPAL_MSM8994
	bool "Compal MSM8994"
	depends on ARCH_MSM8994
	select MACH_COMPAL
	help
	  Support for MSM8994 Compal variants

menu "Compal board selection"

config MACH_PM9X
	bool "PM9X board"
	select MACH_COMPAL_MSM8994
	help
	  Support for Compal PM9X variant

endmenu
```

## drivers/silead/Kconfig
```kconfig
#
# By warren Zhao
#

menuconfig SILEAD_DEVICE
	bool "SILEAD class series devices"
	default n

if SILEAD_DEVICE

config SLSHM
	tristate "shared mem management driver"
	default n
        select SHMEM
	help
		support for IPC 

config SLSPI_DRIVER
	tristate "Silead FP spi deriver"
	default n
	help
		support for IPC 

endif
```
